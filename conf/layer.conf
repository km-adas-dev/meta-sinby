## conf/layer.conf
```bitbake
# We have a conf and classes directory, add to BBPATH
BBPATH .= ":${LAYERDIR}"

# We have recipes-* directories, add to BBFILES
BBFILES += "${LAYERDIR}/recipes-*/*/*.bb \
	${LAYERDIR}/recipes-*/*/*.bbappend"

BBFILE_COLLECTIONS += "sby-zynq"
BBFILE_PATTERN_sby-zynq = "^${LAYERDIR}/"
BBFILE_PRIORITY_sby-zynq = "6"
```
